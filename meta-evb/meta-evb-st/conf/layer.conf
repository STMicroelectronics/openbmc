## meta-evb/meta-evb-st/conf/layer.conf
```bitbake
# We have a conf and classes directory, add to BBPATH
BBPATH .= ":${LAYERDIR}"

BBFILE_COLLECTIONS += "evb-st"
BBFILE_PATTERN_evb-st = ""
BBFILE_PATTERN_IGNORE_EMPTY_evb-st =  "1"
LAYERSERIES_COMPAT_evb-st = "scarthgap styhead walnascar"
```

## meta-evb/meta-evb-st/meta-evb-stm32mp257f-dk/conf/layer.conf
```bitbake
# We have a conf and classes directory, add to BBPATH
BBPATH .= ":${LAYERDIR}"

# We have recipes-* directories, add to BBFILES
BBFILES += "${LAYERDIR}/recipes-*/*/*.bb \
            ${LAYERDIR}/recipes-*/*/*.bbappend"

BBFILE_COLLECTIONS += "evb-stm32mp257f-dk"
BBFILE_PATTERN_evb-stm32mp257f-dk = "^${LAYERDIR}/"

LAYERSERIES_COMPAT_evb-stm32mp257f-dk = "scarthgap styhead walnascar"
BBFILE_PATTERN_IGNORE_EMPTY_evb-stm32mp257f-dk = "1"
```

## meta-evb/meta-evb-st/meta-evb-stm32mp257f-ev1/conf/layer.conf
```bitbake
# We have a conf and classes directory, add to BBPATH
BBPATH .= ":${LAYERDIR}"

# We have recipes-* directories, add to BBFILES
BBFILES += "${LAYERDIR}/recipes-*/*/*.bb \
            ${LAYERDIR}/recipes-*/*/*.bbappend"

BBFILE_COLLECTIONS += "evb-stm32mp257f-ev1"
BBFILE_PATTERN_evb-stm32mp257f-ev1 = "^${LAYERDIR}/"

LAYERSERIES_COMPAT_evb-stm32mp257f-ev1 = "scarthgap styhead walnascar"
BBFILE_PATTERN_IGNORE_EMPTY_evb-stm32mp257f-ev1 = "1"
```

## meta-st/conf/machine/evb-stm32mp257f-dk.conf
```bitbake
#@TYPE: Machine
#@NAME: stm32mp25-dk
#@DESCRIPTION: Configuration for all STM32MP25 disco boards (DK)
#@NEEDED_BSPLAYERS: layers/meta-openembedded/meta-oe layers/meta-openembedded/meta-python

# Define specific familly common machine name
MACHINEOVERRIDES =. "stm32mp2common:stm32mp25common:"

include conf/machine/include/st-machine-common-stm32mp.inc
include conf/machine/include/st-machine-providers-stm32mp.inc

# =========================================================================
# Chip architecture
# =========================================================================
DEFAULTTUNE = "cortexa35"
include conf/machine/include/arm/armv8a/tune-cortexa35.inc

# =========================================================================
# boot scheme
# =========================================================================
BOOTSCHEME_LABELS = "optee"

# =========================================================================
# boot device
# =========================================================================
# Define the boot device supported
BOOTDEVICE_LABELS += "emmc"
BOOTDEVICE_LABELS += "sdcard"

# Define list of devicetree per supported storage
STM32MP_DT_FILES_EMMC   += "stm32mp257f-dk"
STM32MP_DT_FILES_SDCARD += "stm32mp257f-dk"

# =========================================================================
# Machine features
# =========================================================================

# M33
MACHINE_FEATURES += "m33copro"

# FIT
MACHINE_FEATURES:append = " fit"
# put the name of default devicetree to use by default:
FIT_CONF_DEFAULT_DTB = "stm32mp257f-dk.dtb"
#signing key
UBOOT_SIGN_KEYDIR = "${DEPLOY_DIR_IMAGE}"
UBOOT_SIGN_KEYNAME = "my-uboot-sign-key"
# Sign FIT image
# generate new signing key if not exist
UBOOT_SIGN_ENABLE = "1"
FIT_GENERATE_KEYS = "1"
UBOOT_DTB_SIGNED = ""
UBOOT_DTB_BINARY = ""
UBOOT_SIGN_DEPLOY = "0"
# Uboot mkimage option
UBOOT_MKIMAGE_DTCOPTS = "-I dts -O dtb -p 2000"

# PCIe
PCI_LIST += "linux-firmware-rtl8168"

# =========================================================================
# U-BOOT
# =========================================================================
# Content of boot partition
IMAGE_BOOT_FILES ?= "kernel/fitImage-${INITRAMFS_IMAGE}-${MACHINE}-${MACHINE};fitImage "
UBOOT_SUFFIX ?= "stm32mp25-default.bin"

# =========================================================================
# OPTEE
# =========================================================================
# For sdk generation, declare the default board configuration to use.
ST_OPTEE_EXPORT_TA_REF_BOARD:stm32mp2common = "stm32mp257f-dk.dts"

# =========================================================================
# WIC for sdcard raw image
# =========================================================================
WKS_FILE_DEPENDS ?= " \
    virtual/bootloader \
    virtual/trusted-firmware-a \
    virtual-optee-os \
"
OPTEE_WIC_FILE = "emmc-stm32mp257f-dk.wks.in"

WKS_IMAGE_FSTYPES += "wic wic.bz2 wic.bmap"
WKS_FILE += "${OPTEE_WIC_FILE}"

WKS_HOSTFW_SIZE ?= "5G"

# =========================================================================
# Partitions
# =========================================================================

EXTRA_IMAGECMD:ext4 = "-i 4096 -O ^metadata_csum,^dir_index"

# =========================================================================
# OpenBMC
# =========================================================================
require conf/distro/include/phosphor-mmc.inc
require conf/machine/include/obmc-bsp-common.inc
require conf/machine/include/obmc-evb-common.inc
include conf/distro/include/extra-dev-debug-tools.inc

VIRTUAL-RUNTIME_obmc-host-state-manager ?= "x86-power-control"
VIRTUAL-RUNTIME_obmc-chassis-state-manager ?= "x86-power-control"

PREFERRED_PROVIDER_virtual/obmc-chassis-mgmt = "packagegroup-obmc-st-apps"
PREFERRED_PROVIDER_virtual/obmc-fan-mgmt = "packagegroup-obmc-st-apps"
PREFERRED_PROVIDER_virtual/obmc-flash-mgmt = "packagegroup-obmc-st-apps"
PREFERRED_PROVIDER_virtual/obmc-system-mgmt = "packagegroup-obmc-st-apps"
PREFERRED_PROVIDER_virtual/obmc-inventory-data ?= "${VIRTUAL-RUNTIME_skeleton_workbook}"
PREFERRED_PROVIDER_virtual/phosphor-led-manager-config-native = "stm32mp257f-ev1-led-manager-config-native"

OBMC_MACHINE_FEATURES += "\
        obmc-phosphor-fan-mgmt \
        obmc-phosphor-chassis-mgmt \
        obmc-phosphor-flash-mgmt \
        obmc-host-ipmi \
        obmc-host-state-mgmt \
        obmc-chassis-state-mgmt \
        obmc-bmc-state-mgmt \
        "
```
