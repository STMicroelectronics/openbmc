## meta-evb/meta-evb-st/meta-evb-stm32mp257f-ev1/conf/machine/evb-stm32mp257f-ev1.conf
```bitbake
#@TYPE: Machine
#@NAME: stm32mp25-eval
#@DESCRIPTION: Configuration for all STM32MP25 eval boards (EV)
#@NEEDED_BSPLAYERS: layers/meta-openembedded/meta-oe layers/meta-openembedded/meta-python

# Define specific familly common machine name
MACHINEOVERRIDES =. "stm32mp2common:stm32mp25common:"

include conf/machine/include/st-machine-common-stm32mp.inc
include conf/machine/include/st-machine-providers-stm32mp.inc

# =========================================================================
# Chip architecture
# =========================================================================
DEFAULTTUNE = "cortexa35"
include conf/machine/include/arm/armv8a/tune-cortexa35.inc

# =========================================================================
# boot scheme
# =========================================================================
BOOTSCHEME_LABELS = "optee"

# =========================================================================
# boot device
# =========================================================================
# Define the boot device supported
BOOTDEVICE_LABELS += "emmc"
BOOTDEVICE_LABELS += "nor-sdcard"
BOOTDEVICE_LABELS += "sdcard"

# Define list of devicetree per supported storage
STM32MP_DT_FILES_EMMC   += "stm32mp257f-ev1"
STM32MP_DT_FILES_SDCARD += "stm32mp257f-ev1"
STM32MP_DT_FILES_NOR    += "stm32mp257f-ev1"

# =========================================================================
# Machine features
# =========================================================================

# M33
MACHINE_FEATURES += "m33copro"

# FIT
MACHINE_FEATURES:append = " fit"
# put the name of default devicetree to use by default:
FIT_CONF_DEFAULT_DTB = "stm32mp257f-ev1.dtb"
#signing key
UBOOT_SIGN_KEYDIR = "${DEPLOY_DIR_IMAGE}"
UBOOT_SIGN_KEYNAME = "my-uboot-sign-key"
# Sign FIT image
# generate new signing key if not exist
UBOOT_SIGN_ENABLE = "1"
FIT_GENERATE_KEYS = "1"
UBOOT_DTB_SIGNED = ""
UBOOT_DTB_BINARY = ""
UBOOT_SIGN_DEPLOY = "0"
# Uboot mkimage option
UBOOT_MKIMAGE_DTCOPTS = "-I dts -O dtb -p 2000"

# PCIe
PCI_LIST += "linux-firmware-rtl8168"

# =========================================================================
# U-BOOT
# =========================================================================
# Content of boot partition (for ext4 eMMC config)
UBOOT_SUFFIX ?= "stm32mp25-default.bin"


# =========================================================================
# OPTEE
# =========================================================================
# For sdk generation, declare the default board configuration to use.
ST_OPTEE_EXPORT_TA_REF_BOARD:stm32mp2common = "stm32mp257f-ev1.dts"

# =========================================================================
# WIC for sdcard raw image
# --> Comment all to apply NOR configuration
# --> Uncomment all to apply eMMC configuration (default)
# =========================================================================
WKS_FILE_DEPENDS ?= " \
    virtual/bootloader \
    virtual/trusted-firmware-a \
    virtual-optee-os \
"
OPTEE_WIC_FILE = "emmc-stm32mp257f-ev1.wks.in"

WKS_IMAGE_FSTYPES += "wic wic.bz2 wic.bmap"
WKS_FILE += "${OPTEE_WIC_FILE}"

IMAGE_BOOT_FILES ?= "kernel/fitImage-${INITRAMFS_IMAGE}-${MACHINE}-${MACHINE};fitImage "

require conf/distro/include/phosphor-mmc.inc

# =========================================================================
# Partitions and Flash
# =========================================================================

EXTRA_IMAGECMD:ext4 = "-i 4096 -O ^metadata_csum,^dir_index"

FLASH_SIZE = "65536"
# Fixed partition offsets
FLASH_TF_A_1_OFFSET ?= "0"
FLASH_TF_A_2_OFFSET ?= "256"
FLASH_METADATA_1_OFFSET ?= "512"
FLASH_METADATA_2_OFFSET ?= "768"
FLASH_FIP_OFFSET ?= "1024"
FLASH_UBOOT_ENV_OFFSET = "5120"
FLASH_KERNEL_OFFSET ?= "5632"
FLASH_ROFS_OFFSET ?= "18240"
FLASH_RWFS_OFFSET ?= "44800"

# Image to adapt depending on DT name and flash used
FLASH_TF_A_IMAGE ?= "tf-a-stm32mp257f-ev1-optee-nor.stm32"
FLASH_FIP_IMAGE ?= "fip-stm32mp257f-ev1-optee-nor.bin"
FLASH_METADATA_IMAGE ?= "metadata.bin"


# =========================================================================
# OpenBMC
# =========================================================================
require conf/machine/include/obmc-bsp-common.inc
require conf/machine/include/obmc-evb-common.inc

VIRTUAL-RUNTIME_obmc-host-state-manager ?= "x86-power-control"
VIRTUAL-RUNTIME_obmc-chassis-state-manager ?= "x86-power-control"

PREFERRED_PROVIDER_virtual/obmc-chassis-mgmt = "packagegroup-obmc-st-apps"
PREFERRED_PROVIDER_virtual/obmc-fan-mgmt = "packagegroup-obmc-st-apps"
PREFERRED_PROVIDER_virtual/obmc-flash-mgmt = "packagegroup-obmc-st-apps"
PREFERRED_PROVIDER_virtual/obmc-system-mgmt = "packagegroup-obmc-st-apps"
PREFERRED_PROVIDER_virtual/obmc-inventory-data ?= "${VIRTUAL-RUNTIME_skeleton_workbook}"
PREFERRED_PROVIDER_virtual/phosphor-led-manager-config-native = "stm32mp257f-ev1-led-manager-config-native"

OBMC_MACHINE_FEATURES += "\
        obmc-phosphor-fan-mgmt \
        obmc-phosphor-chassis-mgmt \
        obmc-phosphor-flash-mgmt \
        obmc-host-ipmi \
        obmc-host-state-mgmt \
        obmc-chassis-state-mgmt \
        obmc-bmc-state-mgmt \
        "
```
